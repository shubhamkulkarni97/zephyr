## CMakeLists.txt
```
cmake_minimum_required(VERSION 3.8)

set(BOARD esp32)

include($ENV{ZEPHYR_BASE}/cmake/app/boilerplate.cmake NO_POLICY_SCOPE)
project(NONE)

set(WPA_SUPPLICANT_SRCS "${ESP_IDF_PATH}/components/wpa_supplicant/port/os_xtensa.c"
                   "${ESP_IDF_PATH}/components/wpa_supplicant/src/crypto/aes-cbc.c"
                   "${ESP_IDF_PATH}/components/wpa_supplicant/src/crypto/aes-internal-dec.c"
                   "${ESP_IDF_PATH}/components/wpa_supplicant/src/crypto/aes-internal-enc.c"
                   "${ESP_IDF_PATH}/components/wpa_supplicant/src/crypto/aes-internal.c"
                   "${ESP_IDF_PATH}/components/wpa_supplicant/src/crypto/aes-unwrap.c"
                   "${ESP_IDF_PATH}/components/wpa_supplicant/src/crypto/aes-wrap.c"
                   "${ESP_IDF_PATH}/components/wpa_supplicant/src/crypto/bignum.c"
                   "${ESP_IDF_PATH}/components/wpa_supplicant/src/crypto/crypto_mbedtls.c"
                   "${ESP_IDF_PATH}/components/wpa_supplicant/src/crypto/crypto_internal-cipher.c"
                   "${ESP_IDF_PATH}/components/wpa_supplicant/src/crypto/crypto_internal-modexp.c"
                   "${ESP_IDF_PATH}/components/wpa_supplicant/src/crypto/crypto_internal-rsa.c"
                   "${ESP_IDF_PATH}/components/wpa_supplicant/src/crypto/crypto_internal.c"
                   "${ESP_IDF_PATH}/components/wpa_supplicant/src/crypto/des-internal.c"
                   "${ESP_IDF_PATH}/components/wpa_supplicant/src/crypto/dh_group5.c"
                   "${ESP_IDF_PATH}/components/wpa_supplicant/src/crypto/dh_groups.c"
                   "${ESP_IDF_PATH}/components/wpa_supplicant/src/crypto/md4-internal.c"
                   "${ESP_IDF_PATH}/components/wpa_supplicant/src/crypto/md5-internal.c"
                   "${ESP_IDF_PATH}/components/wpa_supplicant/src/crypto/md5.c"
                   "${ESP_IDF_PATH}/components/wpa_supplicant/src/crypto/ms_funcs.c"
                   "${ESP_IDF_PATH}/components/wpa_supplicant/src/crypto/rc4.c"
                   "${ESP_IDF_PATH}/components/wpa_supplicant/src/crypto/sha1-internal.c"
                   "${ESP_IDF_PATH}/components/wpa_supplicant/src/crypto/sha1-pbkdf2.c"
                   "${ESP_IDF_PATH}/components/wpa_supplicant/src/crypto/sha1.c"
                   "${ESP_IDF_PATH}/components/wpa_supplicant/src/crypto/sha256-internal.c"
                   "${ESP_IDF_PATH}/components/wpa_supplicant/src/crypto/sha256.c"
                   "${ESP_IDF_PATH}/components/wpa_supplicant/src/fast_crypto/fast_aes-cbc.c"
                   "${ESP_IDF_PATH}/components/wpa_supplicant/src/fast_crypto/fast_aes-unwrap.c"
                   "${ESP_IDF_PATH}/components/wpa_supplicant/src/fast_crypto/fast_aes-wrap.c"
                   "${ESP_IDF_PATH}/components/wpa_supplicant/src/fast_crypto/fast_crypto_internal-cipher.c"
                   "${ESP_IDF_PATH}/components/wpa_supplicant/src/fast_crypto/fast_crypto_internal-modexp.c"
                   "${ESP_IDF_PATH}/components/wpa_supplicant/src/fast_crypto/fast_crypto_internal.c"
                   "${ESP_IDF_PATH}/components/wpa_supplicant/src/fast_crypto/fast_sha256-internal.c"
                   "${ESP_IDF_PATH}/components/wpa_supplicant/src/fast_crypto/fast_sha256.c"
                   "${ESP_IDF_PATH}/components/wpa_supplicant/src/wpa2/utils/base64.c"
                   "${ESP_IDF_PATH}/components/wpa_supplicant/src/wpa2/utils/ext_password.c"
                   #"${ESP_IDF_PATH}/components/wpa_supplicant/src/wpa2/eap_peer/chap.c"
                   #"${ESP_IDF_PATH}/components/wpa_supplicant/src/wpa2/eap_peer/eap.c"
                   #"${ESP_IDF_PATH}/components/wpa_supplicant/src/wpa2/eap_peer/eap_common.c"
                   #"${ESP_IDF_PATH}/components/wpa_supplicant/src/wpa2/eap_peer/eap_mschapv2.c"
                   #"${ESP_IDF_PATH}/components/wpa_supplicant/src/wpa2/eap_peer/eap_peap.c"
                   #"${ESP_IDF_PATH}/components/wpa_supplicant/src/wpa2/eap_peer/eap_peap_common.c"
                   #"${ESP_IDF_PATH}/components/wpa_supplicant/src/wpa2/eap_peer/eap_tls.c"
                   #"${ESP_IDF_PATH}/components/wpa_supplicant/src/wpa2/eap_peer/eap_tls_common.c"
                   #"${ESP_IDF_PATH}/components/wpa_supplicant/src/wpa2/eap_peer/eap_ttls.c"
                   #"${ESP_IDF_PATH}/components/wpa_supplicant/src/wpa2/eap_peer/mschapv2.c"
                   #"${ESP_IDF_PATH}/components/wpa_supplicant/src/wpa2/tls/asn1.c"
                   #"${ESP_IDF_PATH}/components/wpa_supplicant/src/wpa2/tls/bignum.c"
                   #"${ESP_IDF_PATH}/components/wpa_supplicant/src/wpa2/tls/pkcs1.c"
                   #"${ESP_IDF_PATH}/components/wpa_supplicant/src/wpa2/tls/pkcs5.c"
                   #"${ESP_IDF_PATH}/components/wpa_supplicant/src/wpa2/tls/pkcs8.c"
                   #"${ESP_IDF_PATH}/components/wpa_supplicant/src/wpa2/tls/rsa.c"
                   #"${ESP_IDF_PATH}/components/wpa_supplicant/src/wpa2/tls/tls_internal.c"
                   #"${ESP_IDF_PATH}/components/wpa_supplicant/src/wpa2/tls/tlsv1_client.c"
                   #"${ESP_IDF_PATH}/components/wpa_supplicant/src/wpa2/tls/tlsv1_client_read.c"
                   #"${ESP_IDF_PATH}/components/wpa_supplicant/src/wpa2/tls/tlsv1_client_write.c"
                   #"${ESP_IDF_PATH}/components/wpa_supplicant/src/wpa2/tls/tlsv1_common.c"
                   #"${ESP_IDF_PATH}/components/wpa_supplicant/src/wpa2/tls/tlsv1_cred.c"
                   #"${ESP_IDF_PATH}/components/wpa_supplicant/src/wpa2/tls/tlsv1_record.c"
                   #"${ESP_IDF_PATH}/components/wpa_supplicant/src/wpa2/tls/tlsv1_server.c"
                   #"${ESP_IDF_PATH}/components/wpa_supplicant/src/wpa2/tls/tlsv1_server_read.c"
                   #"${ESP_IDF_PATH}/components/wpa_supplicant/src/wpa2/tls/tlsv1_server_write.c"
                   #"${ESP_IDF_PATH}/components/wpa_supplicant/src/wpa2/tls/x509v3.c"
                   #"${ESP_IDF_PATH}/components/wpa_supplicant/src/wps/eap_common.c"
                   #"${ESP_IDF_PATH}/components/wpa_supplicant/src/wps/uuid.c"
                   #"${ESP_IDF_PATH}/components/wpa_supplicant/src/wps/wps.c"
                   #"${ESP_IDF_PATH}/components/wpa_supplicant/src/wps/wps_attr_build.c"
                   #"${ESP_IDF_PATH}/components/wpa_supplicant/src/wps/wps_attr_parse.c"
                   #"${ESP_IDF_PATH}/components/wpa_supplicant/src/wps/wps_attr_process.c"
                   #"${ESP_IDF_PATH}/components/wpa_supplicant/src/wps/wps_common.c"
                   #"${ESP_IDF_PATH}/components/wpa_supplicant/src/wps/wps_dev_attr.c"
                   #"${ESP_IDF_PATH}/components/wpa_supplicant/src/wps/wps_enrollee.c"
                   #"${ESP_IDF_PATH}/components/wpa_supplicant/src/wps/wps_registrar.c"
                   #"${ESP_IDF_PATH}/components/wpa_supplicant/src/wps/wps_validate.c"
                   )

target_sources(app PRIVATE src/main.c)
target_sources(app PRIVATE src/stubs.c)
target_sources(app PRIVATE src/esp_phy.c)
target_sources(app PRIVATE src/system_api.c)
target_sources(app PRIVATE ${ESP_IDF_PATH}/components/soc/esp32/rtc_clk.c)
target_sources(app PRIVATE ${ESP_IDF_PATH}/components/esp32/ets_timer_legacy.c)
target_sources(app PRIVATE ${ESP_IDF_PATH}/components/esp32/esp_timer.c)
target_sources(app PRIVATE ${ESP_IDF_PATH}/components/esp32/esp_timer_esp32.c)
target_sources(app PRIVATE ${ESP_IDF_PATH}/components/esp32/fast_crypto_ops.c)
target_sources(app PRIVATE ${WPA_SUPPLICANT_SRCS})

#zephyr_sources(${ESP_IDF_PATH}/components/esp32/fast_crypto_ops.c)

zephyr_include_directories(
  src
  )

  zephyr_compile_definitions(
    __ets__
    EMBEDDED_SUPP
    IEEE8021X_EAPOL
    EAP_PEER_METHOD
    EAP_MSCHAPv2
    EAP_PEAP
    USE_WPA2_TASK
    ESPRESSIF_USE
    ESP32_WORKAROUND
    CONFIG_ECC
    )

zephyr_link_libraries(
  ## wifi
  core
  net80211
  wpa
  core
  net80211
  pp
  coexist
  phy
  rtc
  wpa2
  wps
  mesh

  ## esp-idf wifi libs refer gcc libs symbols, so linked in libgcc
  gcc
  -L${ESP_IDF_PATH}/components/esp32
  -L${ESP_IDF_PATH}/components/esp32/lib
  -L${ESP_IDF_PATH}/components/wpa_supplicant
  )
```

## prj.conf
```kconfig
CONFIG_HEAP_MEM_POOL_SIZE=65536
CONFIG_HEAP_MEM_POOL_MIN_SIZE=32000
CONFIG_POSIX_API=y
CONFIG_PTHREAD_IPC=y
CONFIG_POSIX_MQUEUE=y
CONFIG_DYNAMIC_INTERRUPTS=y
CONFIG_MBEDTLS=y

CONFIG_NETWORKING=y
CONFIG_NET_IPV6=n
CONFIG_NET_IPV4=y
CONFIG_NET_ARP=y
CONFIG_NET_UDP=y
CONFIG_NET_DHCPV4=y

CONFIG_INIT_STACKS=y

CONFIG_NET_MGMT=y
CONFIG_NET_MGMT_EVENT=y

#CONFIG_NET_LOG=y
#CONFIG_LOG=y

#CONFIG_SLIP_STATISTICS=n
#CONFIG_NET_SHELL=y

CONFIG_NET_L2_ETHERNET=y
CONFIG_ETH_STELLARIS=y

#CONFIG_ETH_NATIVE_POSIX=y
#CONFIG_ETH_NATIVE_POSIX_MAC_ADDR="00:00:5e:00:53:2a"
```

## src/esp_phy.c
```c
#include <zephyr.h>
#include "esp_phy.h"
#include "rom/ets_sys.h"

static volatile int32_t s_common_clock_enable_ref = 0;
static unsigned int intr_key;

static bool is_wifi_clk_peripheral(periph_module_t periph)
{
    /* A small subset of peripherals use WIFI_CLK_EN_REG and
       CORE_RST_EN_REG for their clock & reset registers */
    switch(periph) {
    case PERIPH_SDMMC_MODULE:
    case PERIPH_SDIO_SLAVE_MODULE:
    case PERIPH_EMAC_MODULE:
    case PERIPH_RNG_MODULE:
    case PERIPH_WIFI_MODULE:
    case PERIPH_BT_MODULE:
    case PERIPH_WIFI_BT_COMMON_MODULE:
    case PERIPH_BT_BASEBAND_MODULE:
    case PERIPH_BT_LC_MODULE:
        return true;
    default:
        return false;
    }
}

static uint32_t get_clk_en_reg(periph_module_t periph)
{
    if (periph == PERIPH_AES_MODULE || periph == PERIPH_SHA_MODULE || periph == PERIPH_RSA_MODULE) {
        return DPORT_PERI_CLK_EN_REG;
    } else {
        return is_wifi_clk_peripheral(periph) ? DPORT_WIFI_CLK_EN_REG : DPORT_PERIP_CLK_EN_REG;
    }
}

static uint32_t get_clk_en_mask(periph_module_t periph)
{
    switch(periph) {
        case PERIPH_RMT_MODULE:
            return DPORT_RMT_CLK_EN;
        case PERIPH_LEDC_MODULE:
            return DPORT_LEDC_CLK_EN;
        case PERIPH_UART0_MODULE:
            return DPORT_UART_CLK_EN;
        case PERIPH_UART1_MODULE:
            return DPORT_UART1_CLK_EN;
        case PERIPH_UART2_MODULE:
            return DPORT_UART2_CLK_EN;
        case PERIPH_I2C0_MODULE:
            return DPORT_I2C_EXT0_CLK_EN;
        case PERIPH_I2C1_MODULE:
            return DPORT_I2C_EXT1_CLK_EN;
        case PERIPH_I2S0_MODULE:
            return DPORT_I2S0_CLK_EN;
        case PERIPH_I2S1_MODULE:
            return DPORT_I2S1_CLK_EN;
        case PERIPH_TIMG0_MODULE:
            return DPORT_TIMERGROUP_CLK_EN;
        case PERIPH_TIMG1_MODULE:
            return DPORT_TIMERGROUP1_CLK_EN;
        case PERIPH_PWM0_MODULE:
            return DPORT_PWM0_CLK_EN;
        case PERIPH_PWM1_MODULE:
            return DPORT_PWM1_CLK_EN;
        case PERIPH_PWM2_MODULE:
            return DPORT_PWM2_CLK_EN;
        case PERIPH_PWM3_MODULE:
            return DPORT_PWM3_CLK_EN;
        case PERIPH_UHCI0_MODULE:
            return DPORT_UHCI0_CLK_EN;
        case PERIPH_UHCI1_MODULE:
            return DPORT_UHCI1_CLK_EN;
        case PERIPH_PCNT_MODULE:
            return DPORT_PCNT_CLK_EN;
        case PERIPH_SPI_MODULE:
            return DPORT_SPI01_CLK_EN;
        case PERIPH_HSPI_MODULE:
            return DPORT_SPI2_CLK_EN;
        case PERIPH_VSPI_MODULE:
            return DPORT_SPI3_CLK_EN;
        case PERIPH_SPI_DMA_MODULE:
            return DPORT_SPI_DMA_CLK_EN;
        case PERIPH_SDMMC_MODULE:
            return DPORT_WIFI_CLK_SDIO_HOST_EN;
        case PERIPH_SDIO_SLAVE_MODULE:
            return DPORT_WIFI_CLK_SDIOSLAVE_EN;
        case PERIPH_CAN_MODULE:
            return DPORT_CAN_CLK_EN;
        case PERIPH_EMAC_MODULE:
            return DPORT_WIFI_CLK_EMAC_EN;
        case PERIPH_RNG_MODULE:
            return DPORT_WIFI_CLK_RNG_EN;
        case PERIPH_WIFI_MODULE:
            return DPORT_WIFI_CLK_WIFI_EN_M;
        case PERIPH_BT_MODULE:
            return DPORT_WIFI_CLK_BT_EN_M;
        case PERIPH_WIFI_BT_COMMON_MODULE:
            return DPORT_WIFI_CLK_WIFI_BT_COMMON_M;
        case PERIPH_BT_BASEBAND_MODULE:
            return DPORT_BT_BASEBAND_EN;
        case PERIPH_BT_LC_MODULE:
            return DPORT_BT_LC_EN;
        case PERIPH_AES_MODULE:
            return DPORT_PERI_EN_AES;
        case PERIPH_SHA_MODULE:
            return DPORT_PERI_EN_SHA;
        case PERIPH_RSA_MODULE:
            return DPORT_PERI_EN_RSA;
        default:
            return 0;
    }
}

static uint32_t get_rst_en_mask(periph_module_t periph, bool enable)
{
    switch(periph) {
        case PERIPH_RMT_MODULE:
            return DPORT_RMT_RST;
        case PERIPH_LEDC_MODULE:
            return DPORT_LEDC_RST;
        case PERIPH_UART0_MODULE:
            return DPORT_UART_RST;
        case PERIPH_UART1_MODULE:
            return DPORT_UART1_RST;
        case PERIPH_UART2_MODULE:
            return DPORT_UART2_RST;
        case PERIPH_I2C0_MODULE:
            return DPORT_I2C_EXT0_RST;
        case PERIPH_I2C1_MODULE:
            return DPORT_I2C_EXT1_RST;
        case PERIPH_I2S0_MODULE:
            return DPORT_I2S0_RST;
        case PERIPH_I2S1_MODULE:
            return DPORT_I2S1_RST;
        case PERIPH_TIMG0_MODULE:
            return DPORT_TIMERGROUP_RST;
        case PERIPH_TIMG1_MODULE:
            return DPORT_TIMERGROUP1_RST;
        case PERIPH_PWM0_MODULE:
            return DPORT_PWM0_RST;
        case PERIPH_PWM1_MODULE:
            return DPORT_PWM1_RST;
        case PERIPH_PWM2_MODULE:
            return DPORT_PWM2_RST;
        case PERIPH_PWM3_MODULE:
            return DPORT_PWM3_RST;
        case PERIPH_UHCI0_MODULE:
            return DPORT_UHCI0_RST;
        case PERIPH_UHCI1_MODULE:
            return DPORT_UHCI1_RST;
        case PERIPH_PCNT_MODULE:
            return DPORT_PCNT_RST;
        case PERIPH_SPI_MODULE:
            return DPORT_SPI01_RST;
        case PERIPH_HSPI_MODULE:
            return DPORT_SPI2_RST;
        case PERIPH_VSPI_MODULE:
            return DPORT_SPI3_RST;
        case PERIPH_SPI_DMA_MODULE:
            return DPORT_SPI_DMA_RST;
        case PERIPH_SDMMC_MODULE:
            return DPORT_SDIO_HOST_RST;
        case PERIPH_SDIO_SLAVE_MODULE:
            return DPORT_SDIO_RST;
        case PERIPH_CAN_MODULE:
            return DPORT_CAN_RST;
        case PERIPH_EMAC_MODULE:
            return DPORT_EMAC_RST;
        case PERIPH_AES_MODULE:
            if (enable == true) {
                // Clear reset on digital signature & secure boot units, otherwise AES unit is held in reset also.
                return (DPORT_PERI_EN_AES | DPORT_PERI_EN_DIGITAL_SIGNATURE | DPORT_PERI_EN_SECUREBOOT);
            } else {
                //Don't return other units to reset, as this pulls reset on RSA & SHA units, respectively.
                return DPORT_PERI_EN_AES;
            }
        case PERIPH_SHA_MODULE:
            if (enable == true) {
                // Clear reset on secure boot, otherwise SHA is held in reset
                return (DPORT_PERI_EN_SHA | DPORT_PERI_EN_SECUREBOOT);
            } else {
                // Don't assert reset on secure boot, otherwise AES is held in reset
                return DPORT_PERI_EN_SHA;
            }
        case PERIPH_RSA_MODULE:
            if (enable == true) {
                // Also clear reset on digital signature, otherwise RSA is held in reset
                return (DPORT_PERI_EN_RSA | DPORT_PERI_EN_DIGITAL_SIGNATURE);
            } else {
                // Don't reset digital signature unit, as this resets AES also
                return DPORT_PERI_EN_RSA;
            }
        case PERIPH_WIFI_MODULE:
        case PERIPH_BT_MODULE:
        case PERIPH_WIFI_BT_COMMON_MODULE:
        case PERIPH_BT_BASEBAND_MODULE:
        case PERIPH_BT_LC_MODULE:
            return 0;
        default:
            return 0;
    }
}

static uint32_t get_rst_en_reg(periph_module_t periph)
{
    if (periph == PERIPH_AES_MODULE || periph == PERIPH_SHA_MODULE || periph == PERIPH_RSA_MODULE) {
        return DPORT_PERI_RST_EN_REG;
    } else {
        return is_wifi_clk_peripheral(periph) ? DPORT_CORE_RST_EN_REG : DPORT_PERIP_RST_EN_REG;
    }
}

void periph_module_enable(periph_module_t periph)
{
    intr_key = irq_lock();
    DPORT_SET_PERI_REG_MASK(get_clk_en_reg(periph), get_clk_en_mask(periph));
    DPORT_CLEAR_PERI_REG_MASK(get_rst_en_reg(periph), get_rst_en_mask(periph, true));
    irq_unlock(intr_key);
}

void periph_module_disable(periph_module_t periph)
{
    intr_key = irq_lock();
    DPORT_CLEAR_PERI_REG_MASK(get_clk_en_reg(periph), get_clk_en_mask(periph));
    DPORT_SET_PERI_REG_MASK(get_rst_en_reg(periph), get_rst_en_mask(periph, false));
    irq_unlock(intr_key);
}

void IRAM_ATTR esp_phy_common_clock_enable(void)
{
    if (s_common_clock_enable_ref == 0) {
        // Enable WiFi/BT common clock
        periph_module_enable(PERIPH_WIFI_BT_COMMON_MODULE);
    }
    s_common_clock_enable_ref++;
}

void IRAM_ATTR esp_phy_common_clock_disable(void)
{
    if (s_common_clock_enable_ref > 0) {
        s_common_clock_enable_ref --;

        if (s_common_clock_enable_ref == 0) {
             // Disable WiFi/BT common clock
             periph_module_disable(PERIPH_WIFI_BT_COMMON_MODULE);
        }
    } else {
        abort();
    }
}
```

## src/esp_phy.h
```c
#include "soc/periph_defs.h"
#include "soc/dport_reg.h"

void IRAM_ATTR esp_phy_common_clock_enable(void);
void IRAM_ATTR esp_phy_common_clock_disable(void);
void periph_module_enable(periph_module_t periph);
void periph_module_disable(periph_module_t periph);
```

## src/stubs.c
```c
#include "stubs.h"


// needs to go into ram due to ISR context
uint32_t phy_enter_critical(void)
{
    //  FreeRTOS function
    //  return portENTER_CRITICAL_NESTED();
    return 0;
}

// needs to go into ram due to ISR context
void phy_exit_critical(uint32_t level)
{
    //  FreeRTOS function
    //portEXIT_CRITICAL_NESTED(level);
    return;
}

/* strnlen() is a POSIX.2008 addition. Can't rely on it being available so
 * define it ourselves.
 */
// size_t strnlen(const char *s, size_t maxlen)
// {
//   const char *p;

//   p = memchr(s, '\0', maxlen);
//   if (p == NULL)
//     return maxlen;

//   return p - s;
// }

void abort(void) {

}


void roundup2(void) {

}

void ets_delay_us(void) {

}

void gpio_output_set(void) {
  
}

void gpio_output_set_high(void) {
  
}

static const unsigned int crc32_le_table[256] = {
    0x00000000L, 0x77073096L, 0xee0e612cL, 0x990951baL, 0x076dc419L, 0x706af48fL, 0xe963a535L, 0x9e6495a3L,
    0x0edb8832L, 0x79dcb8a4L, 0xe0d5e91eL, 0x97d2d988L, 0x09b64c2bL, 0x7eb17cbdL, 0xe7b82d07L, 0x90bf1d91L,
    0x1db71064L, 0x6ab020f2L, 0xf3b97148L, 0x84be41deL, 0x1adad47dL, 0x6ddde4ebL, 0xf4d4b551L, 0x83d385c7L,
    0x136c9856L, 0x646ba8c0L, 0xfd62f97aL, 0x8a65c9ecL, 0x14015c4fL, 0x63066cd9L, 0xfa0f3d63L, 0x8d080df5L,
    0x3b6e20c8L, 0x4c69105eL, 0xd56041e4L, 0xa2677172L, 0x3c03e4d1L, 0x4b04d447L, 0xd20d85fdL, 0xa50ab56bL,
    0x35b5a8faL, 0x42b2986cL, 0xdbbbc9d6L, 0xacbcf940L, 0x32d86ce3L, 0x45df5c75L, 0xdcd60dcfL, 0xabd13d59L,
    0x26d930acL, 0x51de003aL, 0xc8d75180L, 0xbfd06116L, 0x21b4f4b5L, 0x56b3c423L, 0xcfba9599L, 0xb8bda50fL,
    0x2802b89eL, 0x5f058808L, 0xc60cd9b2L, 0xb10be924L, 0x2f6f7c87L, 0x58684c11L, 0xc1611dabL, 0xb6662d3dL,
    0x76dc4190L, 0x01db7106L, 0x98d220bcL, 0xefd5102aL, 0x71b18589L, 0x06b6b51fL, 0x9fbfe4a5L, 0xe8b8d433L,
    0x7807c9a2L, 0x0f00f934L, 0x9609a88eL, 0xe10e9818L, 0x7f6a0dbbL, 0x086d3d2dL, 0x91646c97L, 0xe6635c01L,
    0x6b6b51f4L, 0x1c6c6162L, 0x856530d8L, 0xf262004eL, 0x6c0695edL, 0x1b01a57bL, 0x8208f4c1L, 0xf50fc457L,
    0x65b0d9c6L, 0x12b7e950L, 0x8bbeb8eaL, 0xfcb9887cL, 0x62dd1ddfL, 0x15da2d49L, 0x8cd37cf3L, 0xfbd44c65L,
    0x4db26158L, 0x3ab551ceL, 0xa3bc0074L, 0xd4bb30e2L, 0x4adfa541L, 0x3dd895d7L, 0xa4d1c46dL, 0xd3d6f4fbL,
    0x4369e96aL, 0x346ed9fcL, 0xad678846L, 0xda60b8d0L, 0x44042d73L, 0x33031de5L, 0xaa0a4c5fL, 0xdd0d7cc9L,
    0x5005713cL, 0x270241aaL, 0xbe0b1010L, 0xc90c2086L, 0x5768b525L, 0x206f85b3L, 0xb966d409L, 0xce61e49fL,
    0x5edef90eL, 0x29d9c998L, 0xb0d09822L, 0xc7d7a8b4L, 0x59b33d17L, 0x2eb40d81L, 0xb7bd5c3bL, 0xc0ba6cadL,
    
    0xedb88320L, 0x9abfb3b6L, 0x03b6e20cL, 0x74b1d29aL, 0xead54739L, 0x9dd277afL, 0x04db2615L, 0x73dc1683L,
    0xe3630b12L, 0x94643b84L, 0x0d6d6a3eL, 0x7a6a5aa8L, 0xe40ecf0bL, 0x9309ff9dL, 0x0a00ae27L, 0x7d079eb1L,
    0xf00f9344L, 0x8708a3d2L, 0x1e01f268L, 0x6906c2feL, 0xf762575dL, 0x806567cbL, 0x196c3671L, 0x6e6b06e7L,
    0xfed41b76L, 0x89d32be0L, 0x10da7a5aL, 0x67dd4accL, 0xf9b9df6fL, 0x8ebeeff9L, 0x17b7be43L, 0x60b08ed5L,
    0xd6d6a3e8L, 0xa1d1937eL, 0x38d8c2c4L, 0x4fdff252L, 0xd1bb67f1L, 0xa6bc5767L, 0x3fb506ddL, 0x48b2364bL,
    0xd80d2bdaL, 0xaf0a1b4cL, 0x36034af6L, 0x41047a60L, 0xdf60efc3L, 0xa867df55L, 0x316e8eefL, 0x4669be79L,
    0xcb61b38cL, 0xbc66831aL, 0x256fd2a0L, 0x5268e236L, 0xcc0c7795L, 0xbb0b4703L, 0x220216b9L, 0x5505262fL,
    0xc5ba3bbeL, 0xb2bd0b28L, 0x2bb45a92L, 0x5cb36a04L, 0xc2d7ffa7L, 0xb5d0cf31L, 0x2cd99e8bL, 0x5bdeae1dL,
    0x9b64c2b0L, 0xec63f226L, 0x756aa39cL, 0x026d930aL, 0x9c0906a9L, 0xeb0e363fL, 0x72076785L, 0x05005713L,
    0x95bf4a82L, 0xe2b87a14L, 0x7bb12baeL, 0x0cb61b38L, 0x92d28e9bL, 0xe5d5be0dL, 0x7cdcefb7L, 0x0bdbdf21L,
    0x86d3d2d4L, 0xf1d4e242L, 0x68ddb3f8L, 0x1fda836eL, 0x81be16cdL, 0xf6b9265bL, 0x6fb077e1L, 0x18b74777L,
    0x88085ae6L, 0xff0f6a70L, 0x66063bcaL, 0x11010b5cL, 0x8f659effL, 0xf862ae69L, 0x616bffd3L, 0x166ccf45L,
    0xa00ae278L, 0xd70dd2eeL, 0x4e048354L, 0x3903b3c2L, 0xa7672661L, 0xd06016f7L, 0x4969474dL, 0x3e6e77dbL,
    0xaed16a4aL, 0xd9d65adcL, 0x40df0b66L, 0x37d83bf0L, 0xa9bcae53L, 0xdebb9ec5L, 0x47b2cf7fL, 0x30b5ffe9L,
    0xbdbdf21cL, 0xcabac28aL, 0x53b39330L, 0x24b4a3a6L, 0xbad03605L, 0xcdd70693L, 0x54de5729L, 0x23d967bfL,
    0xb3667a2eL, 0xc4614ab8L, 0x5d681b02L, 0x2a6f2b94L, 0xb40bbe37L, 0xc30c8ea1L, 0x5a05df1bL, 0x2d02ef8dL
};



unsigned int crc32_le(unsigned int crc, unsigned char const * buf,unsigned int len)
{
    unsigned int i;
    crc = ~crc;
    for(i=0;i<len;i++){
        crc = crc32_le_table[(crc^buf[i])&0xff]^(crc>>8);
    }
    return ~crc;
}
```

## src/stubs.h
```c
#include <stdint.h>
#include <string.h>

uint32_t phy_enter_critical(void);
void phy_exit_critical(uint32_t level);

size_t strnlen(const char *s, size_t maxlen);

void abort(void);
void roundup2(void);
void ets_delay_us(void);
void gpio_output_set(void);
void gpio_output_set_high(void);
unsigned int crc32_le(unsigned int crc, unsigned char const * buf,unsigned int len);
```

## src/system_api.c
```c
#include <zephyr.h>
#include "string.h"
#include "wifi_system.h"
#include "soc/efuse_reg.h"

static unsigned int lock_key;

esp_err_t esp_read_mac(uint8_t* mac, esp_mac_type_t type)
{
    uint8_t efuse_mac[6] = {0};
    if (mac == NULL) {
        // ESP_LOGE(TAG, "mac address param is NULL");
        return ESP_ERR_INVALID_ARG;
    }

    if (type < ESP_MAC_WIFI_STA || type > ESP_MAC_ETH) {
        // ESP_LOGE(TAG, "mac type is incorrect");
        return ESP_ERR_INVALID_ARG;
    }

    lock_key = irq_lock();
    uint32_t high = REG_READ(EFUSE_BLK0_RDATA1_REG);
    uint32_t low = REG_READ(EFUSE_BLK0_RDATA2_REG);
    irq_unlock(lock_key);

    for (int i = 3; i >= 0; i--) {
        efuse_mac[2 + i] = (low >> ((i - 1) * 8)) & 0xff;
    }

    efuse_mac[1] = high & 0xff;
    efuse_mac[0] = (high >> 8) & 0xff;

    switch (type) {
    case ESP_MAC_WIFI_STA:
        memcpy(mac, efuse_mac, 6);
        break;
    case ESP_MAC_WIFI_SOFTAP:
        if (UNIVERSAL_MAC_ADDR_NUM == FOUR_UNIVERSAL_MAC_ADDR) {
            memcpy(mac, efuse_mac, 6);
            mac[5] += 1;
        }
        break;
    default:
        // ESP_LOGW(TAG, "incorrect mac type");
        break;
    }

    return ESP_OK;
}
```

## src/wifi_system.h
```c
#include "esp_err.h"

#define TWO_UNIVERSAL_MAC_ADDR 2
#define FOUR_UNIVERSAL_MAC_ADDR 4
#define UNIVERSAL_MAC_ADDR_NUM 4

typedef enum {
    ESP_MAC_WIFI_STA,
    ESP_MAC_WIFI_SOFTAP,
    ESP_MAC_BT,
    ESP_MAC_ETH,
} esp_mac_type_t;

esp_err_t esp_read_mac(uint8_t* mac, esp_mac_type_t type);
```
